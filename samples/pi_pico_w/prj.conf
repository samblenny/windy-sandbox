## prj.conf
```kconfig
# SPDX-License-Identifier: Apache-2.0 OR MIT
# SPDX-FileCopyrightText: Copyright 2025 Sam Blenny

CONFIG_SHELL=y
CONFIG_GPIO=y

# Network stack
CONFIG_NETWORKING=y
CONFIG_NET_OFFLOAD=y
CONFIG_NET_HOSTNAME_ENABLE=y
CONFIG_NET_IPV6=n
CONFIG_NET_IPV4=y
CONFIG_NET_TCP=y
CONFIG_NET_DHCPV4=y

# Wifi support (some of this is also enabled by wifi shell)
CONFIG_NET_CONNECTION_MANAGER=y
CONFIG_WIFI=y
CONFIG_WIFI_NM=y
CONFIG_WIFI_MGMT_FORCED_PASSIVE_SCAN=y

# Shell Extras
CONFIG_NET_SHELL=y
CONFIG_NET_L2_WIFI_SHELL=y

# Debug Extras
CONFIG_NET_MGMT_EVENT_MONITOR=y
CONFIG_NET_MGMT_EVENT_QUEUE_SIZE=10

# Fix "undefined reference to z_impl_sys_rand_get" error when
# compiling network support...
#
# DANGER: TEST_RANDOM_GENERATOR will make TLS connections insecure,
# but the Pi Pico doesn't appear to have an entropy driver that
# sets ENTROPY_HAS_DRIVER. The better option would be to get a
# hardware entropy driver working and use
# CONFIG_ENTROPY_GENERATOR=y with
# CONFIG_ENTROPY_DEVICE_RANDOM_GENERATOR=y
#
CONFIG_TEST_RANDOM_GENERATOR=y
```

## src/main.c
```c
/*
 * build shell from zephyr/samples/subsys/shell/shell_module/
*/
#include <zephyr/shell/shell.h>
```

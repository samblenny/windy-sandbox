## CMakeLists.txt
```
# SPDX-License-Identifier: Apache-2.0 OR MIT
# SPDX-FileCopyrightText: Copyright 2025 Sam Blenny

cmake_minimum_required(VERSION 3.20)
find_package(Zephyr)
project(windy-sandbox)
target_sources(app PRIVATE src/main.c)
```

## prj.conf
```kconfig
# SPDX-License-Identifier: Apache-2.0 OR MIT
# SPDX-FileCopyrightText: Copyright 2025 Sam Blenny

CONFIG_SHELL=y
CONFIG_GPIO=n
```

## src/main.c
```c
/* SPDX-License-Identifier: Apache-2.0 OR MIT */
/* SPDX-FileCopyrightText: Copyright 2025 Sam Blenny */

/*
 * build shell from zephyr/samples/subsys/shell/shell_module/
*/
#include <zephyr/shell/shell.h>
```
